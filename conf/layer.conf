## conf/layer.conf
```bitbake
# We have a conf and classes directory, append to BBPATH
BBPATH .= ":${LAYERDIR}"

# We have a recipes directory, add to BBFILES
BBFILES += "${LAYERDIR}/recipes-*/*/*.bb ${LAYERDIR}/recipes-*/*/*.bbappend"

BBFILE_COLLECTIONS += "go-binary-layer"
BBFILE_PATTERN_go-binary-layer := "^${LAYERDIR}/"
BBFILE_PRIORITY_go-binary-layer = "7"

LAYERDEPENDS_go-binary-layer = "core"
LAYERSERIES_COMPAT_go-binary-layer = "rocko sumo thud warrior zeus dunfell"
```
